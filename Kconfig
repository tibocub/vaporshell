## Kconfig
```kconfig
config VAPOROS_VAPORSHELL
	tristate "vaporshell -- vaporOS's own shell"
	default n
	---help---
		A POSIX-first shell: parser + AST executor, all POSIX expansions,
		redirections, functions, traps and a table of builtins. See
		docs/design.md. Runs as an ordinary NSH builtin for now
		(nsh> vaporshell) -- not wired in as any board's boot entrypoint yet.

if VAPOROS_VAPORSHELL

config VAPOROS_VAPORSHELL_PROGNAME
	string "Program name"
	default "vaporshell"

config VAPOROS_VAPORSHELL_PRIORITY
	int "priority"
	default 100

config VAPOROS_VAPORSHELL_LEDIT
	bool "vaporshell's own line editor"
	default y
	---help---
		Line editing, history and tab completion implemented by vaporshell
		itself (ledit.c), the same code as on Linux. When disabled the
		prompt goes through NuttX's apps/system/readline instead.

config VAPOROS_VAPORSHELL_STACKSIZE
	int "stack size"
	default DEFAULT_TASK_STACKSIZE
	---help---
		Subshells and $(...) run inside the shell's own task (there is no
		fork), so nested substitutions and function calls recurse on this
		stack. Raise it for scripts that nest deeply.

endif
```
