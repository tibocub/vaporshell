## config/Kconfig
```kconfig
# vaporshell configuration (standalone build: `make menuconfig`; see docs/config.md).
# Every symbol here is VASH_*; .config holds CONFIG_VASH_*. With no .config the
# defaults below apply, and they are exactly today's build ("full").

mainmenu "vaporshell configuration"

menu "Build"

choice VASH_OPT
	prompt "Optimization"
	default VASH_OPT_SPEED
	help
	  What the compiler optimizes for.

config VASH_OPT_SPEED
	bool "Speed (-O2)"

config VASH_OPT_SIZE
	bool "Size (-Os)"
	help
	  Smaller code, a little slower. About 22% smaller than -O2 on the
	  full shell (measured on x86-64 with gcc: 399 KB -> 311 KB).

endchoice

config VASH_GC_SECTIONS
	bool "Drop unused functions at link time (--gc-sections)"
	default y
	help
	  Puts every function and variable in its own section and lets the
	  linker discard the ones nothing uses. No downside beyond link time.

config VASH_LTO
	bool "Link-time optimization (-flto)"
	default n
	help
	  Another few percent, a slower build, and the compiler must support
	  it. Combine with Size.

config VASH_STRIP
	bool "Strip symbols from the binary"
	default n
	help
	  Removes the symbol table: about 12% smaller, but crash reports and
	  gdb lose function names.

config VASH_DEBUG
	bool "Debug information (-g)"
	default n

config VASH_HARDEN
	bool "Security hardening flags"
	default y
	help
	  Stack protector, PIE, full RELRO, -D_FORTIFY_SOURCE=2 and friends
	  (docs/security.md). Costs about 3% of the binary on the full shell and
	  about 6% on a stripped, size-optimized one (measured, x86-64 gcc).
	  Turn it off for the smallest possible binary on a machine where the
	  shell is not exposed to untrusted input, or for a toolchain that
	  rejects the flags.

endmenu

menu "Language"

choice VASH_MODES
	prompt "Shell language modes"
	default VASH_MODES_BOTH
	help
	  Which dialects the binary can speak.

config VASH_MODES_BOTH
	bool "bash and POSIX (the default)"
	help
	  Bash mode by default, POSIX mode with --posix, `set -o posix`,
	  POSIXLY_CORRECT or when started as sh.

config VASH_MODES_POSIX_ONLY
	bool "POSIX only"
	help
	  A POSIX (dash-like) shell and nothing else: the compiler drops every
	  bash extension ([[ ]], arrays, ${x//a/b}, brace expansion, mapfile,
	  declare, shopt, pushd, ...). About 21% smaller than both modes on a
	  -Os build (275 KB -> 217 KB, measured).

endchoice

endmenu

menu "Interactive shell"

config VASH_LINE_EDITOR
	bool "Line editor"
	default y
	help
	  Emacs-style editing, cursor keys, Ctrl-R, `bind` and ~/.inputrc.
	  Without it an interactive shell reads plain lines from the terminal
	  (no editing beyond what the tty driver does), which is all a script
	  runner or a serial console needs. About 20 KB.

config VASH_HISTORY
	bool "Command history"
	default y
	depends on VASH_LINE_EDITOR
	help
	  Up/Down, `history`, `fc`, ! expansion and the history file. About 8 KB.

menuconfig VASH_COMPLETION
	bool "Tab completion"
	default y
	depends on VASH_LINE_EDITOR
	help
	  Completion of commands, files, variables, users and hosts; with the
	  options below also the bash `complete`/`compgen` machinery. About 25 KB
	  in all.

if VASH_COMPLETION

config VASH_COMPLETION_PROG
	bool "Programmable completion (complete, compgen, compopt)"
	default y
	help
	  The bash builtins and the spec machinery behind them, so that
	  bash-completion scripts and `complete -F` in an rc file work.
	  Without it Tab still completes commands, files, variables, users and
	  hosts, and `complete`/`compopt` are accepted and ignored (an old
	  .bashrc keeps working). About 12 KB.

config VASH_COMPLETION_FISH
	bool "fish-style completion specs (complete -c ... -s -l -d)"
	default y
	depends on VASH_COMPLETION_PROG
	help
	  The option-with-description specs under completions/. About 3 KB.

config VASH_HIGHLIGHT
	bool "Syntax highlighting while typing"
	default y
	help
	  Commands green or red, quotes, paths, keywords, stray fi/done/esac.

config VASH_AUTOSUGGEST
	bool "History suggestions after the cursor"
	default y

endif # VASH_COMPLETION

config VASH_TITLE
	bool "Terminal title and slow-command timer"
	default y
	depends on VASH_LINE_EDITOR
	help
	  The window title (running command, user@host:dir) and the
	  "took 12s" line after a slow command.

endmenu
```
